## Kconfig
```kconfig
mainmenu "IRBIS OS Linux 0.0.1 Configuration"

config OS_NAME_TEXT
	string "Operation System Name"
	default "IRBIS OS"
	help
	  Name operatioon system:

choice 
	prompt "ARCH"
	default OS_ARCH_x86_64
	
config OS_ARCH_x86_64
	bool "x86_64"
config OS_ARCH_i686
	bool "i686"
	
config OS_ARCH_AMD64
	bool "amd64"
endchoice

config OS_ARCH
	string
	default "i686" if OS_ARCH_i686
	default "amd64" if OS_ARCH_AMD64
	default "x86_64"
	
config OS_VENDOR
	string "Vendor name"
	default "irbis"

config OS_ARCH_TARGET
	string
	default x86_64-irbis-linux-gnu	if OS_ARCH_x86_64
		
source "packages/Kconfig"	
```

## syspackages/packages/Kconfig
```kconfig
config OS_PERL
	bool "Perl"
	default y

config OS_PYTHON
	bool "Python"
	default y

config OS_ZLIB
	bool "Zlib zlib.h"
	depends on OS_PERL
	default y

config OS_LIBMD
	bool "md5.h"
	default y

config OS_LIBXML2
	boot libxml2
	default y

config OS_NETTLE
	bool "nettle"
	default y

config OS_BISON
	bool "bison"
	default y


config OS_AUTOMAKE
	bool "automake"
	default y

config OS_AUTOCONF
	bool "autoconf"
	default y

config OS_PCG_CONFIG
	bool "pkg-config"
	default y


config OS_GNUTLS
	bool "gnutls"
	default y


config OS_WGET
	bool "wget"
	default y

config OS_OPENSSL
	bool "OpenSSL"
	depends on OS_PERL
	depends on OS_ZLIB	
	default y
```
